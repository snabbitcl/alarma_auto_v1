## sistema-alarma-vehicular/firmware/auto/sdkconfig.defaults
```kconfig
# Configuración ESP32-S3 para proyecto AUTO
# ESP-IDF v5.5

# Target
CONFIG_IDF_TARGET="esp32s3"

# Configuración del chip
CONFIG_ESP_DEFAULT_CPU_FREQ_MHZ_240=y
CONFIG_ESP32S3_INSTRUCTION_CACHE_32KB=y
CONFIG_ESP32S3_DATA_CACHE_64KB=y
CONFIG_ESP32S3_DATA_CACHE_LINE_64B=y

# PSRAM
CONFIG_SPIRAM=y
CONFIG_SPIRAM_MODE_OCT=y
CONFIG_SPIRAM_SPEED_80M=y
CONFIG_SPIRAM_USE_MEMMAP=y
CONFIG_SPIRAM_USE_CAPS_ALLOC=y
CONFIG_SPIRAM_USE_MALLOC=y

# Flash Configuration
CONFIG_ESPTOOLPY_FLASHSIZE_8MB=y

# SPI Configuration (solo SPI2 para LoRa) - deshabilitado temporalmente
# CONFIG_SPI2_HOST=y
CONFIG_SPI_MASTER_IN_IRAM=y
CONFIG_SPI_MASTER_ISR_IN_IRAM=y

# Security Features (deshabilitado temporalmente para pruebas)
# CONFIG_SECURE_BOOT=y
# CONFIG_SECURE_BOOT_V2_ENABLED=y
# CONFIG_SECURE_BOOT_BUILD_SIGNED_BINARIES=y
# CONFIG_SECURE_FLASH_ENC_ENABLED=y
# CONFIG_SECURE_FLASH_ENCRYPTION_MODE_RELEASE=y

# eFuse Keys
CONFIG_EFUSE_VIRTUAL=n
CONFIG_EFUSE_VIRTUAL_KEEP_IN_FLASH=n

# BLE Configuration - temporalmente deshabilitado para compilación
# CONFIG_BT_ENABLED=y
# CONFIG_BT_BLUEDROID_ENABLED=n
# CONFIG_BT_NIMBLE_ENABLED=y
# CONFIG_BT_NIMBLE_SM_SC_ONLY=n
# CONFIG_BT_NIMBLE_CRYPTO_STACK_MBEDTLS=y
# CONFIG_BT_NIMBLE_MAX_CONNECTIONS=1
# CONFIG_BT_NIMBLE_ROLE_PERIPHERAL=y

# WiFi/ESP-NOW para mesh networking - algunas opciones comentadas temporalmente
CONFIG_ESP_WIFI_STATIC_RX_BUFFER_NUM=8
CONFIG_ESP_WIFI_DYNAMIC_RX_BUFFER_NUM=16
CONFIG_ESP_WIFI_AMPDU_TX_ENABLED=n
CONFIG_ESP_WIFI_AMPDU_RX_ENABLED=n
CONFIG_ESP_WIFI_AMSDU_TX_ENABLED=n
# CONFIG_ESP_WIFI_ESPNOW_ENABLED=y

# Power Management (menos agresivo que llave) - algunas opciones comentadas
CONFIG_PM_ENABLE=y
CONFIG_PM_DFS_INIT_AUTO=y
# CONFIG_PM_USE_RTC_TIMER_REF=y

# FreeRTOS optimizado para vehicular
CONFIG_FREERTOS_UNICORE=n
CONFIG_FREERTOS_HZ=1000
CONFIG_FREERTOS_USE_TICKLESS_IDLE=n
CONFIG_FREERTOS_IDLE_TASK_STACKSIZE=2048

# Task Watchdog más estricto - actualizado para ESP-IDF v5.5
CONFIG_ESP_TASK_WDT_INIT=y
CONFIG_ESP_TASK_WDT_TIMEOUT_S=5
CONFIG_ESP_TASK_WDT_CHECK_IDLE_TASK_CPU0=y
CONFIG_ESP_TASK_WDT_CHECK_IDLE_TASK_CPU1=y
CONFIG_ESP_TASK_WDT_PANIC=y

# Interrupt Watchdog - comentado temporalmente las opciones problemáticas
CONFIG_ESP_INT_WDT=y
CONFIG_ESP_INT_WDT_TIMEOUT_MS=300
# CONFIG_ESP_INT_WDT_CHECK_CPU0=y
# CONFIG_ESP_INT_WDT_CHECK_CPU1=y

# Brown-out Detection
CONFIG_ESP_BROWNOUT_DET=y
CONFIG_ESP_BROWNOUT_DET_LVL_SEL_7=y

# Optimización para confiabilidad
CONFIG_COMPILER_OPTIMIZATION_SIZE=n
CONFIG_COMPILER_OPTIMIZATION_PERF=y
CONFIG_COMPILER_OPTIMIZATION_ASSERTIONS_ENABLE=y

# Log levels para diagnóstico
CONFIG_LOG_DEFAULT_LEVEL_INFO=y
CONFIG_LOG_MAXIMUM_LEVEL_DEBUG=y
CONFIG_BOOTLOADER_LOG_LEVEL_INFO=y

# Particiones OTA
CONFIG_PARTITION_TABLE_CUSTOM=y
CONFIG_PARTITION_TABLE_CUSTOM_FILENAME="particiones_ota.csv"

# OTA Support - comentado temporalmente
# CONFIG_ESP_HTTPS_OTA_ENABLED=y
CONFIG_ESP_HTTPS_OTA_ALLOW_HTTP=n

# Temperature sensor para anti-tamper
CONFIG_TEMP_SENSOR_ENABLE_DEBUG_LOG=y

# Componentes específicos vehiculares - comentado temporalmente las opciones problemáticas
# CONFIG_ESP_ADC_CAL_ENABLED=y
CONFIG_ADC_ONESHOT_CTRL_FUNC_IN_IRAM=y

# Desactivar componentes no usados - comentado temporalmente las opciones problemáticas
CONFIG_BT_CLASSIC_ENABLED=n
CONFIG_ESP_HTTP_CLIENT_ENABLE_HTTPS=y
# CONFIG_ESP_HTTP_SERVER_ENABLE=n
```

## sistema-alarma-vehicular/firmware/llave/sdkconfig.defaults
```kconfig
# Configuración ESP32-S3 para proyecto LLAVE
# ESP-IDF v5.5

# Target
CONFIG_IDF_TARGET="esp32s3"

# Configuración del chip
CONFIG_ESP32S3_DEFAULT_CPU_FREQ_240=y
CONFIG_ESP32S3_INSTRUCTION_CACHE_32KB=y
CONFIG_ESP32S3_DATA_CACHE_64KB=y
CONFIG_ESP32S3_DATA_CACHE_LINE_64B=y

# PSRAM
CONFIG_SPIRAM=y
CONFIG_SPIRAM_MODE_OCT=y
CONFIG_SPIRAM_SPEED_80M=y
CONFIG_SPIRAM_USE_MEMMAP=y
CONFIG_SPIRAM_USE_CAPS_ALLOC=y
CONFIG_SPIRAM_USE_MALLOC=y

# SPI Configuration
CONFIG_SPI2_HOST=y
CONFIG_SPI3_HOST=y
CONFIG_SPI_MASTER_IN_IRAM=y
CONFIG_SPI_MASTER_ISR_IN_IRAM=y

# Security Features
CONFIG_SECURE_BOOT=y
CONFIG_SECURE_BOOT_V2_ENABLED=y
CONFIG_SECURE_BOOT_BUILD_SIGNED_BINARIES=y
CONFIG_SECURE_FLASH_ENC_ENABLED=y
CONFIG_SECURE_FLASH_ENCRYPTION_MODE_RELEASE=y

# eFuse Keys
CONFIG_EFUSE_VIRTUAL=n
CONFIG_EFUSE_VIRTUAL_KEEP_IN_FLASH=n

# BLE Configuration
CONFIG_BT_ENABLED=y
CONFIG_BT_BLUEDROID_ENABLED=n
CONFIG_BT_NIMBLE_ENABLED=y
CONFIG_BT_NIMBLE_SM_SC_ONLY=y
CONFIG_BT_NIMBLE_CRYPTO_STACK_MBEDTLS=y
CONFIG_BT_NIMBLE_MAX_CONNECTIONS=3
CONFIG_BT_NIMBLE_ROLE_CENTRAL=y
CONFIG_BT_NIMBLE_ROLE_PERIPHERAL=y

# WiFi/ESP-NOW (Opcional)
CONFIG_ESP_WIFI_STATIC_RX_BUFFER_NUM=4
CONFIG_ESP_WIFI_DYNAMIC_RX_BUFFER_NUM=8
CONFIG_ESP_WIFI_AMPDU_TX_ENABLED=n
CONFIG_ESP_WIFI_AMPDU_RX_ENABLED=n
CONFIG_ESP_WIFI_AMSDU_TX_ENABLED=n

# LVGL para GUI
CONFIG_LV_USE_USER_DATA=y
CONFIG_LV_USE_LOG=y
CONFIG_LV_LOG_LEVEL_WARN=y

# Power Management
CONFIG_PM_ENABLE=y
CONFIG_PM_DFS_INIT_AUTO=y
CONFIG_PM_USE_RTC_TIMER_REF=y
CONFIG_ESP_SLEEP_POWER_DOWN_FLASH=y
CONFIG_ESP_SLEEP_RTC_BUS_ISO_WORKAROUND=y

# FreeRTOS
CONFIG_FREERTOS_UNICORE=n
CONFIG_FREERTOS_HZ=1000
CONFIG_FREERTOS_USE_TICKLESS_IDLE=y
CONFIG_FREERTOS_IDLE_TASK_STACKSIZE=1536

# Task Watchdog
CONFIG_ESP_TASK_WDT=y
CONFIG_ESP_TASK_WDT_TIMEOUT_S=10
CONFIG_ESP_TASK_WDT_CHECK_IDLE_TASK_CPU0=y
CONFIG_ESP_TASK_WDT_CHECK_IDLE_TASK_CPU1=y

# Optimización compilador
CONFIG_COMPILER_OPTIMIZATION_SIZE=y
CONFIG_COMPILER_OPTIMIZATION_ASSERTIONS_DISABLE=y

# Log levels para producción
CONFIG_LOG_DEFAULT_LEVEL_INFO=y
CONFIG_LOG_MAXIMUM_LEVEL_INFO=y
CONFIG_BOOTLOADER_LOG_LEVEL_WARN=y

# Particiones
CONFIG_PARTITION_TABLE_CUSTOM=y
CONFIG_PARTITION_TABLE_CUSTOM_FILENAME="particiones.csv"

# Componentes no usados (reducir tamaño)
CONFIG_BT_CLASSIC_ENABLED=n
CONFIG_ESP_HTTP_CLIENT_ENABLE_HTTPS=n
CONFIG_ESP_HTTPS_OTA_ALLOW_HTTP=n
```
